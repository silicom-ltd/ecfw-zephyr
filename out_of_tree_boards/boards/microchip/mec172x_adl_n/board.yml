## out_of_tree_boards/boards/microchip/mec172x_adl_n/board.yml
```yaml
board:
  name: mec172x_adl_n
  vendor: microchip
  socs:
    - name: mec172x_nlj
```

## out_of_tree_boards/boards/microchip/mec172x_adl_n/dts/bindings/i2c/i2c-target-lom-mgmt.yaml
```yaml
# Copyright (c) 2023, Silicom Connectivity Solutions, Ltd.
# SPDX-License-Identifier: Apache-2.0

description: LOM_MGMT I2C Target

compatible: "i2c-target-lom-mgmt"

include: i2c-device.yaml

properties:
  size:
    type: int
    description: Total address space size in bytes
```

## out_of_tree_boards/boards/microchip/mec172x_adl_n_cadiz/board.yml
```yaml
board:
  name: mec172x_adl_n_cadiz
  vendor: microchip
  socs:
    - name: mec172x_nlj
```

## out_of_tree_boards/boards/microchip/mec172x_adl_n_cadiz/dts/bindings/power-domain/silicom,host-power-domain.yaml
```yaml
# Copyright (c) 2026, Silicom Connectivity Solutions, Ltd.
# SPDX-License-Identifier: Apache-2.0

description: |
  Host power domain

  Follows the host (SoC) power state as reported by EC power sequencing.
  It does not switch any rail itself. Devices that only work while the host
  is in S0 reference it with power-domain = <&node>; they are sent
  TURN_OFF when the host leaves S0 and TURN_ON when it returns, and
  pm_device_runtime_get() on them fails with -EAGAIN while the host is off.

  Example:

    host_pd: host-power-domain {
      compatible = "silicom,host-power-domain";
    };

    &some_host_dependent_device {
      power-domain = <&host_pd>;
      zephyr,pm-device-runtime-auto;
    };

compatible: "silicom,host-power-domain"

include: power-domain.yaml
```

## out_of_tree_boards/boards/microchip/mec172x_adl_n_cp/board.yml
```yaml
board:
  name: mec172x_adl_n_cp
  vendor: microchip
  socs:
    - name: mec172x_nlj
```

## tests/thermal_v6/testcase.yaml
```yaml
tests:
  ecfw.thermal.v6:
    platform_allow:
      - native_sim
      - native_posix
    integration_platforms:
      - native_sim
    tags:
      - thermal
      - fan
```

## west.yml
```yaml
manifest:
  version: 0.7

  defaults:
    remote: silicom-ltd
  remotes:
    - name: silicom-ltd
      url-base: https://github.com/silicom-ltd
    - name: upstream
      url-base: https://github.com/zephyrproject-rtos
    - name: microchip
      url-base: https://github.com/MicrochipTech
  projects:
    - name: zephyr
      repo-path: zephyr-silicom
      revision: 203a725f609758bdab33203e9f5f0e7f0c278063
      path: zephyr
      west-commands: scripts/west-commands.yml
    - name: hal_microchip
      remote: upstream
      revision: 5d079f1683a00b801373bbbbf5d181d4e33b30d5
      path: modules/hal/microchip
      groups:
        - hal
    - name: cmsis
      remote: upstream
      revision: 4b96cbb174678dcd3ca86e11e1f24bc5f8726da0
      path: modules/hal/cmsis
      groups:
        - hal
    - name: mcuboot
      remote: upstream
      revision: 5970052c7109faf916c5e3e318ab2ba4cdf85533
      path: bootloader/mcuboot
    - name: CPGZephyrDocs
      remote: microchip
      revision: de150196c8ae5bf00f47c9e2f4cccfafee5844ab
      path: tools
  self:
    path: ecfw-zephyr
```
