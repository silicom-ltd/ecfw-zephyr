/*
 * Copyright (c) 2020 Microchip Technology Inc.
 */

/ {
	zephyr,user {
		sw-die-temp-sensors = <&mfd3_temp>,
				      <&mfd4_temp>,
				      <&mfd5_temp>,
				      <&mfd6_temp_amb>,
				      <&mfd6_temp_hot>,
				      <&mfd7_temp>,
				      <&mfd8_temp_amb>,
				      <&mfd8_temp_hot>;

		sw-amb-temp-sensors = <&switch_temp0>, <&switch_temp1>;

		sw-volt-sensors = <&mfd3_vin>,
				  <&mfd3_vout>,
				  <&mfd4_vin>,
				  <&mfd4_vout>,
				  <&mfd5_vin>,
				  <&mfd5_vout>,
				  <&mfd7_r0_vout>,
				  <&mfd7_r1_vout>,
				  <&mfd7_r2_vout>;

		sw-curr-sensors = <&mfd3_iout>,
				  <&mfd4_iout>,
				  <&mfd5_iout>,
				  <&mfd6_iout>,
				  <&mfd7_r0_iout>,
				  <&mfd7_r1_iout>,
				  <&mfd7_r2_iout>,
				  <&mfd8_iout>;

		sw-powr-sensors = <&mfd6_pin>, <&mfd8_pin>;
	};
};