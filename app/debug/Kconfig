## app/thermal_management_v6/Kconfig
```kconfig
# Kconfig - Config options for EC FW
#
# Copyright (c) 2021 Intel Corporation
# Copyright (c) 2026 Silicom Connectivity Solutions, Ltd.
#
# SPDX-License-Identifier: Apache-2.0
#

menu "Thermal management V6"

config THERMAL_MANAGEMENT_V6
	bool "Enable thermal management V6 (MHO200 adaptive fan speed)"
	depends on !THERMAL_MANAGEMENT && !THERMAL_MANAGEMENT_V2 && \
		   !THERMAL_MANAGEMENT_V3 && !THERMAL_MANAGEMENT_V4
	help
	  Drive the fans from the MHO200 adaptive fan speed profile: a
	  three-cycle rolling average of the two SW ambient thermistors and the
	  CPU ambient, with a two-cycle wait before the first step down. All
	  thermal management versions export the same thread entry point, so
	  only one of them may be enabled at a time.

if THERMAL_MANAGEMENT_V6
config THERMAL_FAN_OVERRIDE
	bool "Enable fan override"
	help
	  Indicate if EC overrides fan control to pre-defined value. This
	  to ensure fan is running before Si parts are fully calibrated.

config THERMAL_FAN_OVERRIDE_VALUE
	int "Fan override duty cycle"
	default 70
	help
	  When EC overrides fan management via SW or HW strap, EC will
	  use this pre-defined duty cycle to control the fan.

config EC_FAN_CONTROL
	bool "Enable EC control"
	help
	  TBD

config PECI_OVER_ESPI_ENABLE
	bool "Enable PECI over ESPI OOB"
	help
	  Indicate if peci over espi oob enabled or not.

config PECI_ACCESS_DISABLE_IN_CS
	bool "Disable PECI access in connected standby"
	help
	  Indicate if PECI access disabled in connected standby to achieve
	  infinite C10 residency.

config THERMAL_MGMT_LOG_LEVEL
	int "Thermal management log level"
	depends on LOG
	default 0
	default 2 if CONFIG_EC_DEBUG_LOG_LEVEL
	help
	  Set log level for thermal management module.
endif
endmenu
```

## dts/bindings/misc/thermal-fan-ctrl-v5.yaml
```yaml
# Copyright (c) 2026, Silicom Connectivity Solutions, Ltd.
# SPDX-License-Identifier: Apache-2.0

description: |
  Thermal management V5 fan-curve configuration (app/thermal_management_v5).

  Groups the sensor/fan device references and the fan-curve lookup table
  that app/thermal_management_v5/thermalmgmt.c reads out of the
  devicetree, so a board adds one node instead of loose properties under
  zephyr,user. There should be exactly one enabled node with this
  compatible per board.

  Example:

    / {
            thermal-fan-ctrl-v5 {
                    compatible = "thermal-fan-ctrl-v5";

                    fan-temp-devices = <&switch_temp0>, <&switch_temp1>;
                    fan-cooling-devices = <&fan1_1>, <&fan1_2>;

                    /* <temp duty>, ascending by temp */
                    fan-curve = <20 40>, <25 45>, <30 50>;
            };
    };

compatible: "thermal-fan-ctrl-v5"

properties:
  fan-temp-devices:
    type: phandles
    required: true
    description: |
      Temperature sensor devices read every cycle; the fan curve is
      driven off the max SENSOR_CHAN_DIE_TEMP reading across all of them.

  fan-cooling-devices:
    type: phandles
    required: true
    description: |
      Fan (PWM) devices driven to the duty cycle selected by the curve.

  fan-curve:
    type: array
    required: true
    description: |
      Fan curve as a flat list of (temp, duty) pairs - degrees Celsius
      ascending, then duty cycle in percent - one pair per curve step,
      e.g. <20 40>, <25 45>, <30 50>. Must list an even number of cells -
      enforced by a BUILD_ASSERT in thermalmgmt.c, not by this binding.
      The first pair's temp is an idle-floor sentinel, not a real
      threshold.

  fan-temp-filter:
    type: int
    default: 5
    description: |
      Moving-average filter window width, in samples. This is the
      default filter; ignored if fan-temp-ema-alpha is set instead.

  fan-temp-ema-alpha:
    type: int
    description: |
      Selects the exponential-moving-average filter instead of the
      moving average. Value is the weight given to the newest sample,
      as a percentage (1-100). Mutually exclusive with fan-temp-filter -
      enforced by a BUILD_ASSERT in thermalmgmt.c, not by this binding.
```

## dts/bindings/thermal/thermal-fan-ctrl-v5-cooling-device.yaml
```yaml
# Copyright (c) 2026, Silicom Connectivity Solutions, Ltd.
# SPDX-License-Identifier: Apache-2.0

description: |
  A single fan, modeled as an independent Linux/Zephyr-style cooling
  device: wraps one physical fan device and gives it its own table of PWM
  duty-cycle levels. Each physical fan gets its own node, so different
  fans can have different level tables and respond to different trips.

  cooling-levels[N] is the PWM duty cycle, in percent, for cooling state
  N - referenced by index from a "thermal-fan-ctrl-v5-cooling-map" node's
  cooling-device entries, e.g.:

    fan1-1-cooling: fan1-1-cooling {
            compatible = "thermal-fan-ctrl-v5-cooling-device";
            #cooling-cells = <2>;
            fan-devices = <&fan1_1>;
            cooling-levels = <40 45 50>;
    };
    ...
    cooling-device = <&fan1_1_cooling 0 2>;  /* state 0 (40%) .. state 2 (50%) */

compatible: "thermal-fan-ctrl-v5-cooling-device"

properties:
  fan-devices:
    type: phandles
    required: true
    description: The underlying fan (PWM) device(s) this cooling device drives.

  cooling-levels:
    type: array
    required: true
    description: |
      PWM duty cycle, in percent, for each cooling state - state N is
      cooling-levels[N]. Referenced by index from cooling-map entries.

cooling-cells:
  - min
  - max
```

## dts/bindings/thermal/thermal-fan-ctrl-v5-cooling-map.yaml
```yaml
# Copyright (c) 2026, Silicom Connectivity Solutions, Ltd.
# SPDX-License-Identifier: Apache-2.0

description: |
  Links one trip (see thermal-fan-ctrl-v5-trip.yaml) to the cooling
  device(s) it drives, as a child of a "thermal-fan-ctrl-v5" zone's
  "cooling-maps" container - modeled on Linux/Zephyr thermal-zones
  cooling-maps.

  Each cooling-device entry is <&cooling_device min max> (see
  thermal-fan-ctrl-v5-cooling-device.yaml): min/max are cooling-state
  indices into that device's own cooling-levels array. thermalmgmt.c
  applies "max" once the temperature crosses above this map's trip, and
  "min" once it falls back below it (each direction independently
  debounced). A map may list multiple cooling-device entries to drive
  several fans off of the one trip.

compatible: "thermal-fan-ctrl-v5-cooling-map"

properties:
  trip:
    type: phandle
    required: true
    description: The trip (thermal-fan-ctrl-v5-trip node) this map applies to.

  cooling-device:
    type: phandle-array
    required: true
    specifier-space: cooling
    description: |
      Cooling device(s) driven once the referenced trip is crossed, each
      as <&device min-state max-state>.
```

## dts/bindings/thermal/thermal-fan-ctrl-v5-trip.yaml
```yaml
# Copyright (c) 2026, Silicom Connectivity Solutions, Ltd.
# SPDX-License-Identifier: Apache-2.0

description: |
  One temperature trip point, as a child of a "thermal-fan-ctrl-v5" zone's
  "trips" container. Modeled on Linux/Zephyr thermal-zones trip points.

  Trips are evaluated independently: each poll, thermalmgmt.c checks every
  trip against the current temperature and applies whichever
  "thermal-fan-ctrl-v5-cooling-map" node(s) reference it (see
  thermal-fan-ctrl-v5-cooling-map.yaml) - a trip does not need to be part
  of a single ordered curve, so different trips can drive different
  cooling devices with an arbitrary temperature-to-cooling-device mapping.

compatible: "thermal-fan-ctrl-v5-trip"

properties:
  temperature:
    type: int
    required: true
    description: Trip temperature, in degrees Celsius.
```

## dts/bindings/thermal/thermal-fan-ctrl-v5.yaml
```yaml
# Copyright (c) 2026, Silicom Connectivity Solutions, Ltd.
# SPDX-License-Identifier: Apache-2.0

description: |
  Thermal management V5 fan-curve zone (app/thermal_management_v5), shaped
  like a Linux/Zephyr thermal-zones node: a zone with sensors, child
  "trips" (temperature thresholds) and child "cooling-maps" (trip ->
  cooling device(s), each an independently-tabled fan - see
  thermal-fan-ctrl-v5-cooling-device.yaml).

  Trips are evaluated independently, not as one ordered curve: each poll,
  thermalmgmt.c checks every trip against the current temperature and
  applies whichever cooling-map(s) reference it. This allows an arbitrary
  temperature-to-cooling-device mapping - different trips can drive
  different fans, and the same fan can be driven by more than one trip.

  There should be exactly one enabled node with this compatible per board,
  normally placed under a plain (compatible-less) "thermal-zones" container
  node, matching the upstream convention:

    / {
            fan1-1-cooling: fan1-1-cooling {
                    compatible = "thermal-fan-ctrl-v5-cooling-device";
                    #cooling-cells = <2>;
                    fan-devices = <&fan1_1>;
                    cooling-levels = <40 45 50>;
            };

            thermal-zones {
                    fan-ctrl-v5: fan-ctrl-v5 {
                            compatible = "thermal-fan-ctrl-v5";
                            thermal-sensors = <&switch_temp0>, <&switch_temp1>;

                            trips {
                                    trip_0: trip-0 {
                                            compatible = "thermal-fan-ctrl-v5-trip";
                                            temperature = <20>;
                                    };
                            };

                            cooling-maps {
                                    map_0: map-0 {
                                            compatible = "thermal-fan-ctrl-v5-cooling-map";
                                            trip = <&trip_0>;
                                            cooling-device = <&fan1_1_cooling 0 1>;
                                    };
                            };
                    };
            };
    };

compatible: "thermal-fan-ctrl-v5"

properties:
  thermal-sensors:
    type: phandles
    required: true
    description: |
      Temperature sensor devices read every cycle; the fan curve is
      driven off the max SENSOR_CHAN_DIE_TEMP reading across all of them.

  fan-temp-filter:
    type: int
    description: |
      Moving-average filter window width, in samples; defaults to 5 if
      unset (applied in thermalmgmt.c via DT_PROP_OR, not by this
      binding - a binding-level "default" would make this property
      synthesize as present even when unset in the devicetree, which
      would break the fan-temp-ema-alpha mutual-exclusivity check
      below). This is the default filter; ignored if fan-temp-ema-alpha
      is set instead.

  fan-temp-ema-alpha:
    type: int
    description: |
      Selects the exponential-moving-average filter instead of the
      moving average. Value is the weight given to the newest sample,
      as a percentage - must be between 1 and 100, and mutually
      exclusive with fan-temp-filter; both are enforced by a
      BUILD_ASSERT in thermalmgmt.c, not by this binding (the
      devicetree binding schema has no numeric range/exclusivity
      constraint of its own).
```

## out_of_tree_boards/boards/arm/mec172x_adl_n_cadiz/dts/bindings/sensor/silicom,board-sensors.yaml
```yaml
# Copyright (c) 2026 Silicom Connectivity Solutions, Ltd
# SPDX-License-Identifier: Apache-2.0

description: |
  Board hwmon sensor aggregation node for mec172x_adl_n_cadiz.

  This node carries no hardware of its own: it just lists, per hwmon class,
  which already-declared sensor channels are reported to the host and in
  what order. drivers/sensors.c reads it via silicom_board_sensors instead
  of enumerating every enabled node of a given compatible (voltage-divider,
  current-sense-amplifier, ntc-thermistor) directly, so board membership and
  host reporting order are explicit here rather than implied by devicetree
  node order.

compatible: "silicom,board-sensors"

properties:
  board-die-temp-sensors:
    type: phandles
    description: |
      Switch/VRM die temperature sensor channels (hwmon "temp" class),
      reported to the host in this order.

  board-amb-temp-sensors:
    type: phandles
    description: |
      Board-ambient temperature sensor channels (hwmon "temp" class),
      reported to the host in this order.

  board-volt-sensors:
    type: phandles
    description: |
      Rail voltage sensor channels (hwmon "in" class), reported to the host
      in this order.

  board-curr-sensors:
    type: phandles
    description: |
      Rail current sensor channels (hwmon "curr" class), reported to the
      host in this order.

  board-powr-sensors:
    type: phandles
    description: |
      PSU input power sensor channels (hwmon "power" class), reported to
      the host in this order.

  board-peci-temp-sensor:
    type: phandle
    description: |
      Device used to read CPU die temperature into hwmon_sram's dedicated
      "peci" struct (a single hwmon "temp" entry, distinct from the mon[]
      array the other board-*-sensors properties above populate). Two
      mutually exclusive mechanisms exist in this codebase, selected in
      drivers/sensors.c: a normal Zephyr sensor-model driver
      (../zephyr/drivers/sensor/x86_peci_temp, compatible "x86-peci-temp")
      read like the phandles properties above via sensor_sample_fetch/
      channel_get -- point this at that node, as this board (cadiz) does --
      or, on a board built with CONFIG_PECI_OVER_ESPI_ENABLE instead,
      drivers/peci_hub.c's own PECI-over-eSPI OOB implementation, which
      resolves its own PECI bus device internally and so does not actually
      use this phandle's target; it only gates whether PECI CPU temp is
      reported at all.
```

## out_of_tree_boards/boards/arm/mec172x_adl_n_cp/Kconfig.board
```kconfig
# Copyright (c) 2025, Silicom Connectivity Solutions
# SPDX-License-Identifier: Apache-2.0

config BOARD_MEC172X_ADL_N_CP
	bool "Silicom ADL-N MEC172X Checkpoint EC"
	depends on SOC_MEC172X_NLJ

config EC_ONBOARD_SWITCHES_DISABLE
	bool "Disable onboard switches support"
	depends on BOARD_MEC172X_ADL_N_CP
```

## out_of_tree_boards/boards/arm/mec172x_adl_n_cp/dts/bindings/gpio/silicom,ec-vgpio.yaml
```yaml
# Copyright (c) 2026 Silicom Connectivity Solutions, Ltd.
# SPDX-License-Identifier: Apache-2.0

description: |
  EC Virtual GPIO Proxy. One child node per EC-owned GPIO line exposed to
  the host through the ACPI mailbox in app/ec_vgpio/ (overlaid onto
  app/smchost's g_acpi_tbl.ec_vgpio_buffer - see ec_vgpio_region.h for the
  host-visible protocol). Line IDs are assigned by child node order
  (0-based) at build time; that order is the single source of truth shared
  with the host-side ASL/driver.

compatible: "silicom,ec-vgpio"

child-binding:
  description: one EC-owned GPIO line exposed to the host
  properties:
    gpios:
      type: phandle-array
      required: true
      description: the physical EC GPIO pin backing this line

    label:
      type: string
      description: |
        Line name reported to the host by mailbox command 4 (max 15
        characters). Defaults to the node name if unset.

    input:
      type: boolean
      description: the host may get() this line's level

    output:
      type: boolean
      description: this line can be driven to a level

    host-settable:
      type: boolean
      description: |
        The host may set() this line (requires 'output'). An 'output'
        line without this property is EC-driven only - reported to the
        host as output-capable but not host-writable.

    irq-capable:
      type: boolean
      description: the host may arm edge interrupts on this line
```
