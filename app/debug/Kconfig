## app/debug/Kconfig
```kconfig
# Kconfig - Config options for EC FW debug module
#
# Copyright (c) 2021 Intel Corporation
#
# SPDX-License-Identifier: Apache-2.0
#

config POSTCODE_MANAGEMENT
	bool "Enable postcode management"
	default y
	help
	  Indicate if BIOS debug port 80 block is enabled and the values
	  are intercepted and display in 7-segment display array.

config POSTCODE_MONITOR_SUPPORT
	bool "Enable postcode monitoring and handler registration framework"
	depends on POSTCODE_MANAGEMENT
	default n
	help
	  Say Y here to enable the postcode monitoring subsystem. This enables
	  an internal notifier chain / callback framework allowing external
	  modules (e.g., LOM-MGMT module) to register custom handlers to
	  receive and display host postcodes in real-time.

config POSTCODE_LOG_LEVEL
	int "Debug Port80 log level"
	depends on LOG
	depends on POSTCODE_MANAGEMENT
	default 0
	default 2 if CONFIG_EC_DEBUG_LOG_LEVEL
	help
	  Set log level for debug Port 80 log level.
```

## app/ec_vgpio/Kconfig
```kconfig
# Kconfig - Config options for the EC Virtual GPIO Proxy
#
# Copyright (c) 2026 Silicom Connectivity Solutions, Ltd.
#
# SPDX-License-Identifier: Apache-2.0
#
menu "EC Virtual GPIO Proxy"

config EC_VGPIO
	bool "Enable EC Virtual GPIO Proxy"
	help
	  Expose EC-owned GPIO lines (get/set/interrupt) to the host through
	  an ACPI mailbox overlaid onto app/smchost's existing ACPI_EC_0
	  channel. Requires a 'silicom,ec-vgpio' devicetree node listing the
	  lines to expose.

if EC_VGPIO

config EC_VGPIO_LOG_LEVEL
	int "EC Virtual GPIO Proxy module log level"
	depends on LOG
	default 0
	default 2 if CONFIG_EC_DEBUG_LOG_LEVEL
	help
	  Set log level for the EC Virtual GPIO Proxy module.

config EC_VGPIO_EVQ_DEPTH
	int "Pending GPIO event queue depth"
	default 16
	range 1 255
	help
	  Number of {line ID, level} edge events the EC buffers before the
	  host drains them via mailbox command 6. Older events are dropped
	  (and the overflow flag set) once the queue is full.

endif # EC_VGPIO

endmenu
```

## app/fan_monitor/Kconfig
```kconfig
# Kconfig - Config options for EC FW
#
# Copyright (c) 2024 Silicom Connectivity Solutions, Ltd.
#
# SPDX-License-Identifier: Apache-2.0
#

menu "Fan Monitor"

config FAN_MONITOR
	bool "Enable FAN monitor"
	help
	  Indicate if EC supports monitoring of fan sources.

config FAN_MONITOR_LOG_LEVEL
	int "Fan monitor log level"
	depends on LOG
	depends on FAN_MONITOR
	default 0
	default 2 if CONFIG_EC_DEBUG_LOG_LEVEL
	help
	  Set log level for fan monitor module.

endmenu
```

## app/fan_sense/Kconfig
```kconfig
# Kconfig - Config options for EC FAN sense inputs
#
# Copyright (c) 2025 Silicom Connectivity Solutions, Ltd.
#
# SPDX-License-Identifier: Apache-2.0
#

config FAN_SENSE
	bool "Enable FAN Sensing function"
	default y
	help
	  Indicate if Fan sensing functionality is enabled.

config FAN_SENSE_LOG_LEVEL
	int "Fan sense log level"
	depends on LOG
	depends on FAN_SENSE
	default 0
	default 2 if CONFIG_EC_DEBUG_LOG_LEVEL
	help
	  Set log level for Fan sense.
```

## app/hwmon/Kconfig
```kconfig
# Kconfig - Config options for the hwmon app module
#
# Copyright (c) 2026 Silicom Connectivity Solutions, Ltd.
#
# SPDX-License-Identifier: Apache-2.0
#

menu "hwmon drivers logging control"

config PECIHUB_LOG_LEVEL
	int "peci hub log level"
	depends on LOG
	default 0
	default 2 if CONFIG_EC_DEBUG_LOG_LEVEL
	help
	  Set log level for peci hub interface.

config FAN_LOG_LEVEL
	int "Fan driver log level"
	depends on LOG
	default 0
	default 2 if CONFIG_EC_DEBUG_LOG_LEVEL
	help
	  Set log level for fan driver.

config BOARD_SENSOR_LOG_LEVEL
	int "set board sensor driver log level"
	depends on LOG
	default 2
	default 4 if CONFIG_EC_DEBUG_LOG_LEVEL
	help
	  Set log level for board sensor driver.

endmenu
```

## app/location/Kconfig
```kconfig
# Kconfig - Config options for EC Maestro location button
#
# Copyright (c) 2026 Silicom Connectivity Solutions, Ltd.
#
# SPDX-License-Identifier: Apache-2.0
#

config LOCATION_BUTTON
	bool "Enable Location Button function"
	default y
	help
	  Indicate if Location button functionality is enabled.

config LOCATION_BUTTON_LOG_LEVEL
	int "Location button log level"
	depends on LOG
	depends on LOCATION_BUTTON
	default 0
	default 2 if CONFIG_EC_DEBUG_LOG_LEVEL
	help
	  Set log level for location button.
```

## app/lom_mgmt/Kconfig
```kconfig
menu "EC LOM management processor"

config LOM_MGMT_PROC
	bool "Enable LOM_MGMT Processing"
	depends on I2C_TARGET_LOM_MGMT
	help
	  Enable LOM_MGMT process module

if LOM_MGMT_PROC

config LOM_MGMT_LARGE_SENSOR_VALUE
	bool "Support for large sensor value"
	default n
	help
	  Enable this option to supports the sensor value large than 131.072

config LOM_MGMT_FUNC_HOST_EVENT
	bool "Host events monitoring support"
	select RING_BUFFER
	default y
	help
	  Enable this option to monitor host events, such as reboot, down.

config HOST_EVENT_ENTRY_MAX
	int "Maxmium log entries for host event"
	depends on LOM_MGMT_FUNC_HOST_EVENT
	default 512
	help
	  Set limits of ring buffer for host event log.

config LOM_MGMT_FUNC_POSTCODE
	bool "BIOS POST code monitoring support"
	depends on POSTCODE_MANAGEMENT
	select POSTCODE_MONITOR_SUPPORT
	select RING_BUFFER
	default n
	help
	  Enable this option to monitor the BIOS Power-On Self-Test (POST)
	  codes from the host system.

config HOST_POSTCODE_ENTRY_MAX
	int "Maxmium log entries for host postcode"
	depends on LOM_MGMT_FUNC_POSTCODE
	default 1024
	help
	  Set limits of entries for host postcode log.

config LOM_MGMT_FUNC_POWER_CTRL
	bool "Power control support"
	default n
	help
	  Enable support for host power control functions (e.g., power on,
	  power off, and reset) via the EC.

config ATTEMPT_GRACEFUL_SHUTDOWN
	bool "Attempt graceful shutdown before forced shutdown"
	depends on LOM_MGMT_FUNC_POWER_CTRL
	default y
	help
	  If enabled, the system will attempt to perform a graceful
	  shutdown before a forced shutdown is executed

config HOST_GRACEFUL_SHUTDOWN_WAIT_TIME
	int "Host graceful shutdown timeout"
	depends on LOM_MGMT_FUNC_POWER_CTRL && ATTEMPT_GRACEFUL_SHUTDOWN
	default 30000
	help
	  The amount of time, in miliseconds, to wait for the host to
	  perform a graceful shutdown before proceeding.

config LOM_MGMT_FUNC_FRU
	bool "FRU data retrieval support"
	default n
	help
	  Enable support for reading FRU and providing it to the LOM.

config LOM_MGMT_FUNC_REPORT_LOM_IP
	bool "Support LOM to report its IP information"
	default y
	help
	  Enable support for LOM to report its IP information.

config LOM_MGMT_FUNC_GET_SYS_IDS
	bool "Support obtaining the SBL version."
	default y
	help
	  Enable support for LOM to get SBL version from EC.

config LOM_MGMT_PROC_LOG_LEVEL
	int "LOM management handler log level"
	depends on LOG
	default 2
	help
	  Set log level for LOM management handler module.

config LOM_MGMT_PROC_DBG_APP
	bool "LOM-MGMT Protocol Application Layer debugging"
	depends on LOG
	depends on LOM_MGMT_PROC_LOG_LEVEL >= 4
	default n
	help
	  Enable debug logging for the LOM-MGMT protocol at the application level

config LOM_MGMT_PROC_DBG_PCODE
	bool "LOM-MGMT protocol's postcode processing debugging"
	depends on LOG && LOM_MGMT_FUNC_POSTCODE
	depends on LOM_MGMT_PROC_LOG_LEVEL >= 4
	default n
	help
	  Enable debug logging for the LOM-MGMT protocol's postcode processing

config LOM_MGMT_PROC_DBG_EVENT
	bool "LOM-MGMT protocol's host_event processing debugging"
	depends on LOG && LOM_MGMT_FUNC_HOST_EVENT
	depends on LOM_MGMT_PROC_LOG_LEVEL >= 4
	default n
	help
	  Enable debug logging for the LOM-MGMT protocol's host_event processing

config LOM_MGMT_PROC_DBG_SENS
	bool "LOM-MGMT protocol's sensor processing debugging"
	depends on LOG
	depends on LOM_MGMT_PROC_LOG_LEVEL >= 4
	default n
	help
	  Enable debug logging for the LOM-MGMT protocol's sensor processing

endif

endmenu
```

## app/peci_monitor/Kconfig
```kconfig
# Kconfig - Config options for EC FW
#
# Copyright (c) 2026 Silicom Connectivity Solutions, Ltd.
#
# SPDX-License-Identifier: Apache-2.0
#

menu "PECI Monitor"

config PECI_MONITOR
	bool "Enable PECI CPU temperature monitor"
	help
	  Indicate if EC supports periodic reporting of CPU die temperature
	  read via PECI (see drivers/sensors.c's peci_temp_update()). Only
	  meaningful on a board whose board-sensors devicetree node declares
	  board-peci-temp-sensor; enable via that board's own defconfig, not
	  globally in prj.conf.

config PECI_MONITOR_LOG_LEVEL
	int "PECI monitor log level"
	depends on LOG
	depends on PECI_MONITOR
	default 0
	default 2 if CONFIG_EC_DEBUG_LOG_LEVEL
	help
	  Set log level for PECI monitor module.

endmenu
```

## app/rstbtn/Kconfig
```kconfig
# Kconfig - Config options for EC FW reset button
#
# Copyright (c) 2023 Silicom Connectivity Solutions, Ltd.
#
# SPDX-License-Identifier: Apache-2.0
#

config RESET_BUTTON
	bool "Enable Reset Button function"
	default y
	help
	  Indicate if Reset button functionality is enabled.

config RESET_BUTTON_HANDLER_MAX
	int "Maximum number of reset button handlers"
	default 2 if LOM_MGMT_FUNC_HOST_EVENT
	default 1
	help
	  This option defines the maximum number of reset button handlers
	  that can be registered in the system simultaneously.


config RESET_BUTTON_LOG_LEVEL
	int "Reset button log level"
	depends on LOG
	depends on RESET_BUTTON
	default 0
	default 2 if CONFIG_EC_DEBUG_LOG_LEVEL
	help
	  Set log level for Reset button.
```

## app/smbus_cmi/Kconfig
```kconfig
# Kconfig - Config options for the ACPI SMBus Control Method Interface
#
# Copyright (c) 2026 Silicom Connectivity Solutions, Ltd.
#
# SPDX-License-Identifier: Apache-2.0
#
menu "SMBus Control Method Interface (CMI)"

config SMBUS_CMI
	bool "Enable ACPI SMBus Control Method Interface"
	help
	  Relay ACPI SMBus Control Method Interface (SMBus CMI) requests from
	  the host to a devicetree-selected I2C/SMBus bus. The host addresses
	  the interface through app/smchost's existing ACPI_EC_0 channel,
	  using the acpi_smb_buffer region already reserved there - there is
	  no dedicated ACPI EC channel for this module.

if SMBUS_CMI

config SMBUS_CMI_LOG_LEVEL
	int "SMBus CMI module log level"
	depends on LOG
	default 0
	default 2 if CONFIG_EC_DEBUG_LOG_LEVEL
	help
	  Set log level for the SMBus CMI module.

endif # SMBUS_CMI

endmenu
```

## app/sw_power/Kconfig
```kconfig
# Kconfig - Config options for Checkpoint switch power
#
# Copyright (c) 2025 Silicom Connectivity Solutions, Ltd.
#
# SPDX-License-Identifier: Apache-2.0
#

config SW_POWER_SIGNAL 
	bool "Enable Switch Power signal function"
	default y
	help
	  Indicate if switch power on/off functionality is enabled.

config SW_POWER_SIGNAL_LOG_LEVEL
	int "switch button log level"
	depends on LOG
	depends on SW_POWER_SIGNAL
	default 0
	default 2 if CONFIG_EC_DEBUG_LOG_LEVEL
	help
	  Set log level for switch power signal.
```

## app/thermal_management_v4/Kconfig
```kconfig
# Kconfig - Config options for EC FW
#
# Copyright (c) 2021 Intel Corporation
#
# SPDX-License-Identifier: Apache-2.0
#

menu "Thermal management"

config THERMAL_MANAGEMENT_V4
	bool "Enable thermal management"
	help
	  Indicate if EC supports management of fan, reading thermal
	  sensors and cpu temperature.

if THERMAL_MANAGEMENT_V4
config THERMAL_FAN_OVERRIDE
	bool "Enable fan override"
	help
	  Indicate if EC overrides fan control to pre-defined value. This
	  to ensure fan is running before Si parts are fully calibrated.

config THERMAL_FAN_OVERRIDE_VALUE
	int "Fan override duty cycle"
	default 70
	help
	  When EC overrides fan management via SW or HW strap, EC will
	  use this pre-defined duty cycle to control the fan.

config THERMAL_MGMT_NEGATIVE_HYSTERESIS
	int "Negative hysteresis for fan control"
	default 3
	help
	  Number of degrees of negative hysteresis to use for fan
	  control.  To slow the fan down, the temperature must fall this
	  many degrees below the entry temperature of the current fan step.
	  Default 3 = conservative/Rule B (stays cooler longer); set to 2
	  for Rule A. Provisional pending Beny/David confirmation.

config THERMAL_MGMT_CONFIRM_MS
	int "Ramp-up change confirmation delay (ms)"
	default 1500
	help
	  When a temperature reading first crosses a fan step upward, the EC
	  waits this many milliseconds and takes a second reading before
	  raising the fan; the step only changes if the second reading agrees.
	  This is a debounce on step entry ("2 consecutive readings") that
	  rejects single-sample sensor glitches. The >=65C -> 100% safety jump
	  is not delayed. Set 0 to disable the confirm read (act on a single
	  reading).

config EC_FAN_CONTROL
	bool "Enable EC control"
	help
	  TBD

config PECI_OVER_ESPI_ENABLE
	bool "Enable PECI over ESPI OOB"
	help
	  Indicate if peci over espi oob enabled or not.

config PECI_ACCESS_DISABLE_IN_CS
	bool "Disable PECI access in connected standby"
	help
	  Indicate if PECI access disabled in connected standby to achieve
	  infinite C10 residency.

config THERMAL_MGMT_LOG_LEVEL
	int "Thermal management log level"
	depends on LOG
	default 0
	default 2 if CONFIG_EC_DEBUG_LOG_LEVEL
	help
	  Set log level for thermal management module.
endif
endmenu
```

## app/thermal_management_v5/Kconfig
```kconfig
# Kconfig - Config options for EC FW
#
# Copyright (c) 2021 Intel Corporation
#
# SPDX-License-Identifier: Apache-2.0
#

menu "Thermal management"

config THERMAL_MANAGEMENT_V5
	bool "Enable thermal management"
	help
	  Indicate if EC supports management of fan, reading thermal
	  sensors and cpu temperature.

if THERMAL_MANAGEMENT_V5
config THERMAL_FAN_OVERRIDE
	bool "Enable fan override"
	help
	  Indicate if EC overrides fan control to pre-defined value. This
	  to ensure fan is running before Si parts are fully calibrated.

config THERMAL_FAN_OVERRIDE_VALUE
	int "Fan override duty cycle"
	default 70
	help
	  When EC overrides fan management via SW or HW strap, EC will
	  use this pre-defined duty cycle to control the fan.

config THERMAL_MGMT_NEGATIVE_HYSTERESIS
	int "Negative hysteresis for fan control"
	default 0
	help
	  Number of degrees of negative hysteresis to use for fan
	  control.  To slow the fan down, the temperature must fall this
	  many degrees below the entry temperature of the current fan step.
	  Default 0 = no degree hysteresis (Beny profile): the fan tracks
	  the table directly and the anti-chatter comes from the ramp-up
	  debounce plus the 60s ramp-down rate limit. Set 1+ to add a
	  temperature dead-band on top.

config THERMAL_MGMT_CONFIRM_MS
	int "Ramp-up change confirmation delay (ms)"
	default 1500
	help
	  When a temperature reading first crosses a fan step upward, the EC
	  waits this many milliseconds and takes a second reading before
	  raising the fan; the step only changes if the second reading agrees.
	  This is a debounce on step entry ("2 consecutive readings") that
	  rejects single-sample sensor glitches. Applies to every upward step
	  including 100%. Set 0 to disable the confirm read (act on a single
	  reading).

config EC_FAN_CONTROL
	bool "Enable EC control"
	help
	  TBD

config PECI_OVER_ESPI_ENABLE
	bool "Enable PECI over ESPI OOB"
	help
	  Indicate if peci over espi oob enabled or not.

config PECI_ACCESS_DISABLE_IN_CS
	bool "Disable PECI access in connected standby"
	help
	  Indicate if PECI access disabled in connected standby to achieve
	  infinite C10 residency.

config THERMAL_MGMT_LOG_LEVEL
	int "Thermal management log level"
	depends on LOG
	default 0
	default 2 if CONFIG_EC_DEBUG_LOG_LEVEL
	help
	  Set log level for thermal management module.
endif
endmenu
```
