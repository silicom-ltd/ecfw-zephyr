## app/current_monitor/Kconfig
```kconfig
# Kconfig - Config options for EC FW
#
# Copyright (c) 2024 Silicom Connectivity Solutions, Ltd.
#
# SPDX-License-Identifier: Apache-2.0
#

menu "Current Monitor"

config CURRENT_MONITOR
	bool "Enable current monitor"
	help
	  Indicate if EC supports monitoring of current sources.

config CURRENT_MONITOR_LOG_LEVEL
	int "Current monitor log level"
	depends on LOG
	depends on CURRENT_MONITOR
	default 0
	default 2 if CONFIG_EC_DEBUG_LOG_LEVEL
	help
	  Set log level for current management module.

endmenu
```

## app/leds/Kconfig
```kconfig
# Kconfig - Config options for EC FW
#
# Copyright (c) 2021 Intel Corporation
#
# SPDX-License-Identifier: Apache-2.0
#

config LED_MANAGEMENT
	bool "Enable led management"
	default y
	help
	  Indicate if EC supports management of leds.

config LED_MGMT_LOG_LEVEL
	int "Led management log level"
	depends on LOG
	depends on LED_MANAGEMENT
	default 0
	default 2 if CONFIG_EC_DEBUG_LOG_LEVEL
	help
	  Set log level for thermal management module.

config LED_MANAGEMENT_POST
	bool "Enable POST routine for led testing"
	depends on LED_MANAGEMENT
	default n
	help
	  Enables a 1 second thread that changes the led settings

config GPIO_MANAGEMENT
	bool "Enable GPIO host management"
	default y
	help
	  Indicate if EC supports host management of gpios.
```

## app/thermal_management_v2/Kconfig
```kconfig
# Kconfig - Config options for EC FW
#
# Copyright (c) 2023 Silicom Connectivity Solutions, Ltd.
#
# SPDX-License-Identifier: Apache-2.0
#

menu "Thermal management V2"

config THERMAL_MANAGEMENT_V2
	bool "Enable thermal management V2"
	help
	  Indicate if EC supports management of fan, reading thermal
	  sensors and cpu temperature.  Fan speed determined by internal LUT.

config THERMAL_FAN_OVERRIDE_V2
	bool "Enable fan override"
	help
	  Indicate if EC overrides fan control to pre-defined value. This
	  to ensure fan is running before Si parts are fully calibrated.

config THERMAL_FAN_OVERRIDE_VALUE_V2
	int "Fan override rpm"
	default 3000
	help
	  When EC overrides fan management via SW or HW strap, EC will
	  use this pre-defined rpm to control the fan.

config EC_FAN_CONTROL_V2
	bool "Enable EC control"
	help
	  TBD

config THERMAL_MGMT_LOG_LEVEL_V2
	int "Thermal management log level"
	depends on LOG
	depends on THERMAL_MANAGEMENT_V2
	default 0
	default 2 if CONFIG_EC_DEBUG_LOG_LEVEL
	help
	  Set log level for thermal management module.

endmenu
```

## app/voltage_monitor/Kconfig
```kconfig
# Kconfig - Config options for EC FW
#
# Copyright (c) 2024 Silicom Connectivity Solutions, Ltd.
#
# SPDX-License-Identifier: Apache-2.0
#

menu "Voltage Monitor"

config VOLTAGE_MONITOR
	bool "Enable voltage monitor"
	help
	  Indicate if EC supports monitoring of voltage sources.

config VOLTAGE_MONITOR_LOG_LEVEL
	int "Voltage monitor log level"
	depends on LOG
	depends on VOLTAGE_MONITOR
	default 0
	default 2 if CONFIG_EC_DEBUG_LOG_LEVEL
	help
	  Set log level for voltage management module.

endmenu
```

## app/vrtt/Kconfig
```kconfig
# Kconfig - Config options for EC FW debug module
#
# Copyright (c) 2022 Silicom Connectivity Solutions, Ltd.
#
# SPDX-License-Identifier: Apache-2.0
#

config VRTT_TESTING
	bool "Enable VRTT testing"
	default y
	help
	  Indicate if VRTT testing sample code is enabled.

config VRTT_LOG_LEVEL
	int "VRTT testing log level"
	depends on LOG
	depends on VRTT_TESTING
	default 0
	default 2 if CONFIG_EC_DEBUG_LOG_LEVEL
	help
	  Set log level for VRTT testing.
```

## boards/mec172x_azbeach.conf
```kconfig
# Zephyr-based EC FW

# EC FW features configuration
# ----------------------------
# Minimum eSPI capabilities in reference board
CONFIG_POWER_SEQUENCE_MINIMUM_ESPI_CAPS=y

# Disable DeepSx
CONFIG_PWRMGMT_DEEPSX=n

# Thermal management override for power-on
CONFIG_THERMAL_FAN_OVERRIDE=y

CONFIG_PECI_OVER_ESPI_ENABLE=y

# EC keyscan configuration
CONFIG_KSCAN_EC=n
CONFIG_PS2_KEYBOARD_AND_MOUSE=n

# Support deprecated SMChost commands for backward compatibility
CONFIG_DEPRECATED_SMCHOST_CMD=y

# Zephyr kernel/driver configuration required by EC FW
# ----------------------------------------------------
#CONFIG_ESPI_PERIPHERAL_8042_KBC=y

# Enable non-bot critical drivers
CONFIG_PS2=n
CONFIG_PWM=y
CONFIG_SENSOR=y
CONFIG_PECI=y

# Keep SAF still disabled for now
CONFIG_ESPI_SAF=n

CONFIG_EC_ONBOARD_SWITCHES_DISABLE=y
CONFIG_DNX_SUPPORT=n
CONFIG_POSTCODE_MANAGEMENT=n
CONFIG_KSCAN=n
CONFIG_SOC_DEBUG_AWARENESS=n
```

## out_of_tree_boards/boards/arm/mec172x_adl_n/Kconfig.board
```kconfig
# Copyright (c) 2024, Silicom Connectivity Solutions
# SPDX-License-Identifier: Apache-2.0

config BOARD_MEC172X_ADL_N
	bool "Silicom ADL-N MEC172X EC"
	depends on SOC_MEC172X_NLJ

config EC_ONBOARD_SWITCHES_DISABLE
	bool "Disable onboard switches support"
	depends on BOARD_MEC172X_ADL_N
```

## out_of_tree_boards/boards/arm/mec172x_adl_n/dts/bindings/sensor/ntc-thermistor.yaml
```yaml
# Copyright (c) 2023 Silicom Connectivity Solutions, Ltd
# SPDX-License-Identifier: Apache-2.0

description: NTC Thermistor Temperature Sensor

compatible: "ntc-thermistor"

include: sensor-device.yaml

properties:
  io-channels:
    required: true
    type: phandle-array
    description: |
      IO channel of the ADC to read the NTC thermistor voltage

  rnominal:
    required: true
    type: int
    description: |
      Nominal resistance.

  tnominal:
    required: true
    type: int
    description: |
      Temperature at which rnominal is measured.

  rpullup:
    required: true
    type: int
    description: |
      Value of pullup resistor for ADC input.

  b-const:
    required: true
    type: int
    description: |
      The B constant value of the thermistor.  Consult datasheet.

  resolution:
    type: int
    default: 10
    description: |
      The resolution (in bits) of the ADC reading.

  t-start:
    type: int
    default: -40
    description: |
      The start (lowest) temperature reading to generate.

  t-stop:
    type: int
    default: 125
    description: |
      The ending (highest) temperature reading to generate.
```

## out_of_tree_boards/boards/arm/mec172x_adl_n_cadiz/drivers/gpio/Kconfig
```kconfig
# Microchip BGPO
#
# Copyright (c) 2023 Silicom Connectivity Solutions, Ltd
# SPDX-License-Identifier: Apache-2.0

config BGPO_XEC
	bool "BGPO device configuration"
	default y
	depends on DT_HAS_MICROCHIP_XEC_BGPO_ENABLED
	help
	  Enable BGPO driver for Microchip XEC MECU series.
```

## out_of_tree_boards/boards/arm/mec172x_adl_n_cp/dts/bindings/gpio/microchip,xec-bgpo.yaml
```yaml
description: Microchip CEC/MEC BGPO node

compatible: "microchip,xec-bgpo"

include: gpio-controller.yaml
include: pinctrl-device.yaml
include: base.yaml

properties:
  reg:
    required: true

  pinctrl-0:
    type: phandles
    required: true

  pinctrl-names:
    type: string-array
    required: true
```

## out_of_tree_boards/boards/arm/mec172x_azbeach/Kconfig.board
```kconfig
# Copyright (c) 2022, Silicom Connectivity Solutions
# SPDX-License-Identifier: Apache-2.0

config BOARD_MEC172X_AZBEACH
	bool "Silicom Arizona Beach MEC172X EC"
	depends on SOC_MEC172X_NSZ

config EC_ONBOARD_SWITCHES_DISABLE
	bool "Disable onboard switches support"
	depends on BOARD_MEC172X_AZBEACH
```

## out_of_tree_boards/boards/arm/mec172x_azbeach/drivers/Kconfig
```kconfig
source "drivers/sensor/Kconfig"
source "drivers/led/Kconfig"
source "drivers/pwm/Kconfig"
```

## out_of_tree_boards/boards/arm/mec172x_azbeach/drivers/led/Kconfig
```kconfig
config LED_PWM_MC
	bool "PWM Controlled Multicolor LED driver"
	default y
	depends on PWM && DT_HAS_PWM_LEDS_MULTICOLOR_ENABLED
	help
	  Enable driver for PWM-driven Multicolor LEDS
```

## out_of_tree_boards/boards/arm/mec172x_azbeach/drivers/pwm/Kconfig
```kconfig
# Microchip XEC RPM2PWM configuration options
#
# Copyright (c) 2023 Silicom Connectivity Solutions, Ltd.
# SPDX-License-Identifier: Apache-2.0

config RPM2PWM_XEC
	bool "Microchip XEC RPM2PWM"
	default y
	depends on DT_HAS_MICROCHIP_XEC_RPM2PWM_ENABLED
	select PINCTRL
	help
	  Enable driver to utilize RPM2PWM on the Microchip XEC IP block.
```

## out_of_tree_boards/boards/arm/mec172x_azbeach/drivers/sensor/Kconfig
```kconfig
# NTC Thermistor temperature sensing options
#
# Copyright (c) 2023 Silicom Connectivity Solutions, Ltd
# SPDX-License-Identifier: Apache-2.0

config NTC_THERMISTOR
	bool "NTC Thermistor Temperature Sensor"
	default y
	depends on DT_HAS_NTC_THERMISTOR_ENABLED
	depends on ADC
	help
	  Enable driver for NTC Thermistor Temperature Sensing via ADC
```

## out_of_tree_boards/boards/arm/mec172x_azbeach/dts/bindings/pwm-leds-multicolor.yaml
```yaml
# Copyright (c) 2023 Silicom Connectivity Solutions Ltd.
# SPDX-License-Identifier: Apache-2.0

description: PWM LEDS Multicolor parent node

compatible: "pwm-leds-multicolor"

properties:
    label:
      description: |
        Human readable string describing the device and used to set the device
        name. It can be passed as argument to device_get_binding() to retrieve
        the device. If this property is omitted, then the device name is set
        from the node full name.

child-binding:
    description: |
        Bindings to describe multi-color LEDs that are grouped from individual
        PWM nodes.

    properties:
        color:  
            description: |
                Multicolor LEDs should define this as RGB (which needs to be defined)
            type: int
            required: true
        max-brightness:
            description: Maximum brightness of the LED
            required: false
            type: int

    child-binding:
        description: The individual PWM nodes that make up the RGB LED
        properties:
            pwms:
                required: true
                type: phandle-array
            color:
                required: true
                type: int
```

## out_of_tree_boards/boards/arm/mec172x_azbeach/dts/bindings/pwm/microchip,xec-rpm2pwm.yaml
```yaml
# Copyright (c) 2023, Silicom Connectivity Solutions, Ltd.
# SPDX-License-Identifier: Apache-2.0

description: Microchip XEC RPM2PWM

include: [pwm-controller.yaml, base.yaml, pinctrl-device.yaml]

compatible: "microchip,xec-rpm2pwm"

properties:
  reg:
    required: true

  pcrs:
    type: array
    required: true
    description: RPM2PWM PCR register index and bit position

  "#pwm-cells":
    const: 3
  
  girqs:
    type: array
    required: true
    description: |
      Array of encoded interrupt information

  pinctrl-0:
    required: true

  pinctrl-names:
    required: true

child-binding:
  child-binding:
    properties:
      pwms:
        required: true
        type: phandle-array
        description: |
          Reference to RPM2PWM instance.

          The period field is ignored, period is fixed in hardware.  Flags 
          should be used to set the desired spin-up and update period etc.
          of the rpm2pwm fan controller.

      edges:
        required: true
        type: int
        description: |
          Number of edges on this fan that are needed to count a single 
          revolution.

pwm-cells:
  - channel
  - period
  - flags
```

## out_of_tree_boards/boards/arm/mec172x_azbeach/mec172x_azbeach_defconfig
```kconfig
#
# Copyright (c) 2022, Silicom Connectivity Solutions
#
# SPDX-License-Identifier: Apache-2.0
#

CONFIG_SOC_MEC172X_NLJ=y
CONFIG_SOC_SERIES_MEC172X=y
CONFIG_BOARD_MEC172X_AZBEACH=y
CONFIG_RTOS_TIMER=y

CONFIG_CLOCK_CONTROL=y
CONFIG_GPIO=y
CONFIG_PINCTRL=y
CONFIG_SERIAL=y
CONFIG_CONSOLE=y
CONFIG_UART_CONSOLE=y
CONFIG_ADC=y
CONFIG_I2C=n
CONFIG_ESPI=y
CONFIG_PWM=y
CONFIG_SENSOR=y
CONFIG_EEPROM=y
#CONFIG_BGPO_XEC=y
#CONFIG_VCI_XEC_V2=y
CONFIG_SPI=y
CONFIG_PECI=y
CONFIG_LED=y
CONFIG_RESET=y
#CONFIG_LED_GPIO=y
CONFIG_ESPI_PERIPHERAL_8042_KBC=n

CONFIG_EC_ONBOARD_SWITCHES_DISABLE=y
#CONFIG_BOARD_ID_IO_EXPANDER=n
CONFIG_SOC_LOG_LEVEL_DBG=y

CONFIG_ESPI_PERIPHERAL_UART_SOC_MAPPING=2
```

## out_of_tree_boards/boards/microchip/mec172x_adl_n_cp/dts/bindings/led/pwm-leds-multicolor.yaml
```yaml
# Copyright (c) 2023, Silicom Connectivity Solutions, Ltd.
# SPDX-License-Identifier: Apache-2.0

description: Multicolor PWM LED parent node

compatible: "pwm-leds-multicolor"

include: ["led-controller.yaml"]

child-binding:
  description: PWM LED child node
  properties:
    pwms:
      required: true
      type: phandle-array

    color-mapping:
      required: true
      type: array
```
